## config/Kconfig
```kconfig
#
# config/Kconfig: Main menu structure definition
# Copyright (C) 2002-2006, 2009 by Robert Schwebel <r.schwebel@pengutronix.de>
#

mainmenu "PTXdist $(PTXDIST_VERSION_FULL)"

source "generated/project_specific.in"
source "generated/fixme.in"

source "generated/project_name.in"

source "rules/Kconfig"
```
